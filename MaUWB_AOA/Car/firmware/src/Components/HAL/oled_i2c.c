/************************************************************************************
*  Copyright (c), 2014, HelTec Automatic Technology co.,LTD.
*            All rights reserved.
*
* Http:    www.heltec.cn
* Email:   cn.heltec@gmail.com
* WebShop: heltec.taobao.com
*
* File name: OLED_I2C.c
* Project  : HelTec.uvprij
* Processor: STM32F103C8T6
* Compiler : MDK fo ARM
* 
* Author : 小林
* Version: 1.00
* Date   : 2014.4.8
* Email  : hello14blog@gmail.com
* Modification: none
* 
* Description:128*64点阵的OLED显示屏驱动文件，仅适用于惠特自动化(heltec.taobao.com)的SD1306驱动IIC通信方式显示屏
*
* Others: none;
*
* Function List:
*	1. void I2C_Configuration(void) -- 配置CPU的硬件I2C
* 2. void I2C_WriteByte(uint8_t addr,uint8_t data) -- 向寄存器地址写一个byte的数据
* 3. void WriteCmd(unsigned char I2C_Command) -- 写命令
* 4. void WriteDat(unsigned char I2C_Data) -- 写数据
* 5. void OLED_Init(void) -- OLED屏初始化
* 6. void OLED_SetPos(unsigned char x, unsigned char y) -- 设置起始点坐标
* 7. void OLED_Fill(unsigned char fill_Data) -- 全屏填充
* 8. void OLED_CLS(void) -- 清屏
* 9. void OLED_ON(void) -- 唤醒
* 10. void OLED_OFF(void) -- 睡眠
* 11. void OLED_ShowStr(unsigned char x, unsigned char y, unsigned char ch[], unsigned char TextSize) -- 显示字符串(字体大小有6*8和8*16两种)
* 12. void OLED_ShowCN(unsigned char x, unsigned char y, unsigned char N) -- 显示中文(中文需要先取模，然后放到codetab.h中)
* 13. void OLED_DrawBMP(unsigned char x0,unsigned char y0,unsigned char x1,unsigned char y1,unsigned char BMP[]) -- BMP图片
*
* History: none;
*
*************************************************************************************/
#include "oled_i2c.h"
#include "hal_iic.h"
/***************************16*16的点阵字体取模方式：共阴——列行式——逆向输出*********/
unsigned char F16x16[] =
{
	
	0x00,0x00,0x40,0x20,0x18,0x07,0x04,0x04,0xE4,0x1E,0x04,0x00,0x00,0x00,0x00,0x00,/*"久",0*/
  0x40,0x40,0x20,0x20,0x10,0x08,0x04,0x03,0x00,0x03,0x0C,0x10,0x20,0x60,0x20,0x00,
	
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  0x00,0x7F,0x20,0x20,0x20,0x2F,0x24,0x24,0x24,0x2F,0x20,0x20,0x20,0x7F,0x00,0x00,
};

/************************************6*8的点阵************************************/
const unsigned char F6x8[][6] =
{
	0x00, 0x00, 0x00, 0x00, 0x00, 0x00,// sp
	0x00, 0x00, 0x00, 0x2f, 0x00, 0x00,// !
	0x00, 0x00, 0x07, 0x00, 0x07, 0x00,// "
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	0x14, 0x14, 0x14, 0x14, 0x14, 0x14,// horiz lines
};
/****************************************8*16的点阵************************************/
const unsigned char F8X16[]=	  
{
  0x00,0x00,0x00,0x00,0x00,0x00,0x00,0x00,0x00,0x00,0x00,0x00,0x00,0x00,0x00,0x00,// 0
  0x00,0x00,0x00,0xF8,0x00,0x00,0x00,0x00,0x00,0x00,0x00,0x33,0x30,0x00,0x00,0x00,//! 1
  0x00,0x10,0x0C,0x06,0x10,0x0C,0x06,0x00,0x00,0x00,0x00,0x00,0x00,0x00,0x00,0x00,//" 2
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  0x00,0x06,0x01,0x01,0x02,0x02,0x04,0x04,0x00,0x00,0x00,0x00,0x00,0x00,0x00,0x00,//~ 94
};

unsigned char BMP1[] =
{
	0x00,0x03,0x05,0x09,0x11,0xFF,0x11,0x89,0x05,0xC3,0x00,0xE0,0x00,0xF0,0x00,0xF8,
	0x00,0x00,0x00,0x00,0x00,0x00,0x00,0x44,0x28,0xFF,0x11,0xAA,0x44,0x00,0x00,0x00,
	0x00,0x00,0x00,0x00,0x00,0x00,0x00,0x00,0x00,0x00,0x00,0x00,0x00,0x00,0x00,0x00,
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	0x80,0xFF,0x80,0xEE,0xEE,0xEE,0xF5,0xFB,0xFF,0x9C,0xBE,0xB6,0xB6,0x88,0xFF,0x00,/*"D:\DreamSpark\OLED\MP3_UI.bmp",0*/
};



void OLED_Configuration(void)
{
	IIC_Init();	//软件IIC 
	OLED_Init();
	OLED_Fill(0xFF);
	OLED_CLS();
	OLED_display(1);
	OLED_display(3);
}

void I2C_WriteByte(uint8_t addr,uint8_t data)
{
	uint8_t SET_Data[2]={0};//{0x18,0xC6}
	SET_Data[0]=data;

I2C_ByteWrite(OLED_ADDRESS,data,addr);
//	
//I2C_BufferWrite(I2C2,OLED_ADDRESS,addr,SET_Data,1);
}

void WriteCmd(unsigned char I2C_Command)//写命令
{
	I2C_WriteByte(0x00, I2C_Command);
}

void WriteDat(unsigned char I2C_Data)//写数据
{
	I2C_WriteByte(0x40, I2C_Data);
}

void OLED_Init(void)
{
	Delay_ms(200); //这里的延时很重要	
	WriteCmd(0xAE); //display off
	WriteCmd(0x20);	//Set Memory Addressing Mode	
	WriteCmd(0x10);	//00,Horizontal Addressing Mode;01,Vertical Addressing Mode;10,Page Addressing Mode (RESET);11,Invalid
	WriteCmd(0xb0);	//Set Page Start Address for Page Addressing Mode,0-7
	WriteCmd(0xc8);	//Set COM Output Scan Direction
	WriteCmd(0x00); //---set low column address
	WriteCmd(0x10); //---set high column address
	WriteCmd(0x40); //--set start line address
	WriteCmd(0x81); //--set contrast control register
	WriteCmd(0xff); //亮度调节 0x00~0xff
	WriteCmd(0xa1); //--set segment re-map 0 to 127
	WriteCmd(0xa6); //--set normal display
	WriteCmd(0xa8); //--set multiplex ratio(1 to 64)
	WriteCmd(0x3F); //
	WriteCmd(0xa4); //0xa4,Output follows RAM content;0xa5,Output ignores RAM content
	WriteCmd(0xd3); //-set display offset
	WriteCmd(0x00); //-not offset
	WriteCmd(0xd5); //--set display clock divide ratio/oscillator frequency
	WriteCmd(0xf0); //--set divide ratio
	WriteCmd(0xd9); //--set pre-charge period
	WriteCmd(0x22); //
	WriteCmd(0xda); //--set com pins hardware configuration
	WriteCmd(0x12);
	WriteCmd(0xdb); //--set vcomh
	WriteCmd(0x20); //0x20,0.77xVcc
	WriteCmd(0x8d); //--set DC-DC enable
	WriteCmd(0x14); //
	WriteCmd(0xaf); //--turn on oled panel
}

void OLED_SetPos(unsigned char x, unsigned char y) //设置起始点坐标
{ 
	WriteCmd(0xb0+y);
	WriteCmd(((x&0xf0)>>4)|0x10);
	WriteCmd((x&0x0f)|0x01);
}

void OLED_Fill(unsigned char fill_Data)//全屏填充
{
	unsigned char m,n;
	for(m=0;m<8;m++)
	{
		WriteCmd(0xb0+m);		//page0-page1
		WriteCmd(0x00);		//low column start address
		WriteCmd(0x10);		//high column start address
		for(n=0;n<128;n++)
			{
				WriteDat(fill_Data);
			}
	}
}

void OLED_CLS(void)//清屏
{
	OLED_Fill(0x00);
}

//--------------------------------------------------------------
// Prototype      : void OLED_ON(void)
// Calls          : 
// Parameters     : none
// Description    : 将OLED从休眠中唤醒
//--------------------------------------------------------------
void OLED_ON(void)
{
	WriteCmd(0X8D);  //设置电荷泵
	WriteCmd(0X14);  //开启电荷泵
	WriteCmd(0XAF);  //OLED唤醒
}

//--------------------------------------------------------------
// Prototype      : void OLED_OFF(void)
// Calls          : 
// Parameters     : none
// Description    : 让OLED休眠 -- 休眠模式下,OLED功耗不到10uA
//--------------------------------------------------------------
void OLED_OFF(void)
{
	WriteCmd(0X8D);  //设置电荷泵
	WriteCmd(0X10);  //关闭电荷泵
	WriteCmd(0XAE);  //OLED休眠
}

//--------------------------------------------------------------
// Prototype      : void OLED_ShowChar(unsigned char x, unsigned char y, unsigned char ch[], unsigned char TextSize)
// Calls          : 
// Parameters     : x,y -- 起始点坐标(x:0~127, y:0~7); ch[] -- 要显示的字符串; TextSize -- 字符大小(1:6*8 ; 2:8*16)
// Description    : 显示codetab.h中的ASCII字符,有6*8和8*16可选择
//--------------------------------------------------------------
void OLED_ShowStr(unsigned char x, unsigned char y, unsigned char ch[], unsigned char TextSize)
{
	unsigned char c = 0,i = 0,j = 0;
	switch(TextSize)
	{
		case 1:
		{
			while(ch[j] != '\0')
			{
				c = ch[j] - 32;
				if(x > 126)
				{
					x = 0;
					y++;
				}
				OLED_SetPos(x,y);
				for(i=0;i<6;i++)
					WriteDat(F6x8[c][i]);
				x += 6;
				j++;
			}
		}break;
		case 2:
		{
			while(ch[j] != '\0')
			{
				c = ch[j] - 32;
				if(x > 120)
				{
					x = 0;
					y++;
				}
				OLED_SetPos(x,y);
				for(i=0;i<8;i++)
					WriteDat(F8X16[c*16+i]);
				OLED_SetPos(x,y+1);
				for(i=0;i<8;i++)
					WriteDat(F8X16[c*16+i+8]);
				x += 8;
				j++;
			}
		}break;
	}
}

//--------------------------------------------------------------
// Prototype      : void OLED_ShowCN(unsigned char x, unsigned char y, unsigned char N)
// Calls          : 
// Parameters     : x,y -- 起始点坐标(x:0~127, y:0~7); N:汉字在codetab.h中的索引
// Description    : 显示codetab.h中的汉字,16*16点阵
//--------------------------------------------------------------
void OLED_ShowCN(unsigned char x, unsigned char y, unsigned char N)
{
	unsigned char wm=0;
	unsigned int  adder=32*N;
	OLED_SetPos(x , y);
	for(wm = 0;wm < 16;wm++)
	{
		WriteDat(F16x16[adder]);
		adder += 1;
	}
	OLED_SetPos(x,y + 1);
	for(wm = 0;wm < 16;wm++)
	{
		WriteDat(F16x16[adder]);
		adder += 1;
	}
}

//--------------------------------------------------------------
// Prototype      : void OLED_DrawBMP(unsigned char x0,unsigned char y0,unsigned char x1,unsigned char y1,unsigned char BMP[]);
// Calls          : 
// Parameters     : x0,y0 -- 起始点坐标(x0:0~127, y0:0~7); x1,y1 -- 起点对角线(结束点)的坐标(x1:1~128,y1:1~8)
// Description    : 显示BMP位图
//--------------------------------------------------------------
void OLED_DrawBMP(unsigned char x0,unsigned char y0,unsigned char x1,unsigned char y1,unsigned char BMP[])
{
	unsigned int j=0;
	unsigned char x,y;

  if(y1%8==0)
		y = y1/8;
  else
		y = y1/8 + 1;
	for(y=y0;y<y1;y++)
	{
		OLED_SetPos(x0,y);
    for(x=x0;x<x1;x++)
		{
			WriteDat(BMP[j++]);
		}
	}
}

/**************************************************************************LEDD打印控制**************************************************************************/

/**************************************************************************
函数名  ：OLED_display
函数功能：初始OLED显示
入口参数：需要显示的字符组
返回  值：无 
**************************************************************************/ 
void OLED_display(int word)
{
	switch(word)		
	{ 
		case 1: OLED_CLS();OLED_ShowCN(19,3,0);OLED_ShowCN(45,3,1);OLED_ShowCN(71,3,2);OLED_ShowCN(97,3,3);break;//显示公司名	

		case 2: OLED_CLS();OLED_ShowCN(11,0,8);OLED_ShowCN(41,0,9);OLED_ShowCN(75,0,9);OLED_ShowCN(105,0,14);//显示  遥控控制
				OLED_ShowCN(0,3,18);OLED_ShowCN(16,3,5);OLED_ShowStr(32,3, ":", 2); //显示 速度:
				OLED_ShowCN(64,3,27);OLED_ShowStr(80,3, ":", 2);//显示 中：
				OLED_ShowCN(0,6,20);OLED_ShowStr(16,6, ":", 2);OLED_ShowCN(64,6,19);OLED_ShowStr(80,6, ":", 2);break;//显示 左：   右： 

		case 3: OLED_CLS();OLED_ShowCN(11,0,10);OLED_ShowCN(41,0,11);OLED_ShowCN(75,0,12);OLED_ShowCN(105,0,13);//显示 跟随模式 
				OLED_ShowCN(16,3,6);OLED_ShowCN(32,3,7);OLED_ShowStr(48,3, ":", 2);OLED_ShowCN(88,3,25);//显示 距离： 米
				OLED_ShowCN(16,6,4);OLED_ShowCN(32,6,5);OLED_ShowStr(48,6, ":", 2);OLED_ShowCN(88,6,5);break;//显示 角度： 度			

		case 4: OLED_ShowCN(63,3,21);OLED_ShowCN(79,3,22);break;//显示按键

		case 5: OLED_ShowCN(63,3,8);OLED_ShowCN(79,3,9);break;//显示遥控

		case 6: OLED_CLS();OLED_ShowCN(19,0,23);OLED_ShowCN(45,0,24);OLED_ShowCN(71,0,12);OLED_ShowCN(97,0,13);//显示避障模式
				OLED_ShowCN(8,3,6);OLED_ShowCN(24,3,7);OLED_ShowCN(40,3,19);OLED_ShowStr(56,3, ":", 2);//显示 距离左：	
				OLED_ShowCN(8,6,6);OLED_ShowCN(24,6,7);OLED_ShowCN(40,6,20);OLED_ShowStr(56,6, ":", 2);break;//显示距离右：	
		default:break;
	}
	Delay_ms(1);
}

/**************************************************************************
函数名  ：OLED_Remote_Display
函数功能：初始OLED显示
入口参数：需要显示的字符组
返回  值：无 
**************************************************************************/ 
void OLED_Remote_Display(uint8_t OLED_N)
{
		switch(OLED_N)		
		{ 
			case 1: //OLED_CLS();OLED_ShowCN(19,3,8);OLED_ShowCN(45,3,9);OLED_ShowCN(71,3,9);OLED_ShowCN(97,3,14);//显示 遥控模式
					OLED_ShowCN(11,0,8);OLED_ShowCN(41,0,9);OLED_ShowCN(75,0,9);OLED_ShowCN(105,0,14);//显示 遥控模式
			break;
			
			case 2: //OLED_CLS();OLED_ShowCN(19,3,28);OLED_ShowCN(45,3,29);OLED_ShowCN(71,3,12);OLED_ShowCN(97,3,13);//显示 召回模式
					OLED_ShowCN(11,0,28);OLED_ShowCN(41,0,29);OLED_ShowCN(75,0,12);OLED_ShowCN(105,0,13);//显示 召回模式
			break;
  
			case 3: OLED_ShowCN(11,0,10);OLED_ShowCN(41,0,11);OLED_ShowCN(75,0,12);OLED_ShowCN(105,0,13.);//显示 跟随模式 
			break;
			
			default:break;
		}
}

/**************************************************************************
函数名  ：OLED_display
函数功能：设备模式显示，改变状态时才打印一次
入口参数：aoa_mode与aoa_recal的按键状态
返回  值：无 
#define Follow_mode     2     //跟随模式
#define Recall_mode     3     //召回模式
#define Remote_mode     4     //遥控模式
**************************************************************************/ 
void OLED_ALL_Display(uint8_t All_mode)
{
	static uint8_t OLED_N=0;
	if(All_mode==4)//遥控模式
	{
		if(OLED_N != 1){OLED_N=1;OLED_Remote_Display(OLED_N);}
	}
	else if(All_mode==3)//召回模式  
	{
		if(OLED_N != 2){OLED_N=2;OLED_Remote_Display(OLED_N);}
	}
	else if(All_mode==2)//跟随模式  
	{
		if(OLED_N != 3){OLED_N=3;OLED_Remote_Display(OLED_N);}
	}
}
/**************************************************************************
函数名  ：OLED_Follow_Data_Display
函数功能：显示当前AOA角度距离
入口参数：New_distance,New_Angle 需要打印的参数,打印时间在45ms左右,只在改变参数时才打印一次
返回  值：无 
**************************************************************************/ 
void OLED_Follow_Data_Display(int New_distance,int New_Angle)
{
	uint8_t buf[32]={0};
	const float epsilon = 10; // 可以根据需要调整此值
	
	float Display_dis=0xff;
	int Display_Angle=0xff;//打印角度与距离
	int New_dis=New_distance,New_An=New_Angle;
	static int Last_Display_dis=0, Last_Display_An=0;
	
	if(Last_Display_dis==0xff)
	{
		Last_Display_dis=New_dis;Display_dis=Last_Display_dis;
	}
	else if (abs(New_dis - Last_Display_dis) >= epsilon)
	{
//		_dbg_printf("%.2f %.2f %f\n",New_dis,Last_Display_dis,fabs(New_dis - Last_Display_dis));
		Last_Display_dis=New_dis;
		Display_dis=Last_Display_dis;
    } 

	if(Last_Display_An==0xff)
	{
		Last_Display_An=New_An;Display_Angle=Last_Display_An;
	}
	else if (New_An != Last_Display_An )
	{
//		_dbg_printf("%.2f %.2f %f\n",New_dis,Last_Display_dis,fabs(New_dis - Last_Display_dis));
		Last_Display_An=New_An;
		Display_Angle=Last_Display_An;
    } 
	
	if(Display_dis !=0xff && abs(Display_dis)<9999)//显示当前AOA的距离值
	{ 
		memset(buf, 0, sizeof(buf));
		if(Display_dis<=9) {sprintf(buf,"%0.2f",Display_dis/100);}
		else if(Display_dis<=999) {sprintf(buf,"%0.2f",Display_dis/100);}
			else if(Display_dis<=9999) {sprintf(buf,"%0.1f",Display_dis/100);}
		else  {sprintf(buf,"%0.2f",Display_dis/100);}
		OLED_ShowStr(56,3,buf,2);	
	}
	
	
	if(Display_Angle !=0xff && abs(Display_Angle)<=99 && Display_Angle>0)//显示当前AOA的角度值
	{
		memset(buf, 0, sizeof(buf));
		if(Display_Angle>=9  ) {sprintf(buf," %d ",Display_Angle);}
		else if(Display_Angle>=99) {sprintf(buf," %d ",Display_Angle);}
		else  {sprintf(buf," %d ",Display_Angle);}
		OLED_ShowStr(56,6,buf,2);	
	}
	else if(Display_Angle !=0xff && abs(Display_Angle)<=99 && Display_Angle<0)
	{
		memset(buf, 0, sizeof(buf));
		if(Display_Angle>=-9) {sprintf(buf,"%d",Display_Angle);}
		else if(Display_Angle>=-99) {sprintf(buf,"%d",Display_Angle);}
		else  {sprintf(buf,"%d",Display_Angle);}
		OLED_ShowStr(56,6,buf,2);	
	}	
}
